## conf/bblayers.conf
```bitbake
# LAYER_CONF_VERSION is increased each time build/conf/bblayers.conf
# changes incompatibly
LCONF_VERSION = "6"

BBPATH = "${TOPDIR}"
BBFILES ?= ""
BSPDIR := "${@os.path.abspath(os.path.dirname(d.getVar('FILE', True)) + '/../..')}"


BBLAYERS = " \
  ${BSPDIR}/poky/meta \
  ${BSPDIR}/poky/meta-yocto \
  ${BSPDIR}/poky/meta-yocto-bsp \
  \
  ${BSPDIR}/meta-multimedia \
  \
  ${BSPDIR}/meta-rpi \
  \
  ${BSPDIR}/meta-YoctoCamera \
"
```

## conf/local.conf
```bitbake
# raspberri pi
MACHINE = "raspberrypi"
VIDEO_CAMERA = "1"
KERNEL_IMAGETYPE = "uImage"

# YoctoCamera
IMAGE_INSTALL_append = " mjpg-streamer linux-firmware wireless-tools dnsmasq wpa-supplicant mc"
# 2GB extra rootfs space (in KB)
#IMAGE_ROOTFS_EXTRA_SPACE = "2097152"

# Generic
DISTRO ?= "poky"
PACKAGE_CLASSES ?= "package_rpm"
EXTRA_IMAGE_FEATURES = "debug-tweaks"
USER_CLASSES ?= "image-mklibs image-prelink"
PATCHRESOLVE = "noop"
BB_DISKMON_DIRS = "\
    STOPTASKS,${TMPDIR},1G,100K \
    STOPTASKS,${DL_DIR},1G,100K \
    STOPTASKS,${SSTATE_DIR},1G,100K \
    ABORT,${TMPDIR},100M,1K \
    ABORT,${DL_DIR},100M,1K \
    ABORT,${SSTATE_DIR},100M,1K" 
PACKAGECONFIG_append_pn-qemu-native = " sdl"
PACKAGECONFIG_append_pn-nativesdk-qemu = " sdl"
ASSUME_PROVIDED += "libsdl-native"
CONF_VERSION = "1"

DL_DIR = "${TOPDIR}/../downloads"
SSTATE_DIR = "${TOPDIR}/../sstate-cache"
```

## meta-YoctoCamera/conf/layer.conf
```bitbake
# We have a conf and classes directory, add to BBPATH
BBPATH .= ":${LAYERDIR}"

# We have recipes-* directories, add to BBFILES
BBFILES += "${LAYERDIR}/recipes-*/*/*.bb \
	${LAYERDIR}/recipes-*/*/*.bbappend"

BBFILE_COLLECTIONS += "YoctoCamera"
BBFILE_PATTERN_YoctoCamera = "^${LAYERDIR}/"
BBFILE_PRIORITY_YoctoCamera = "7"
```
